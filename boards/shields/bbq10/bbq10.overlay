
#include <dt-bindings/zmk/matrix_transform.h>


/ {
    chosen {
        zmk,kscan = &kscan0;
    };

    kscan0: kscan {
        compatible = "zmk,kscan-gpio-matrix";

        /* Rows */
        row-gpios = <
            &gpio0 17 GPIO_ACTIVE_LOW   /* ROW1  D2  P0.17 */
            &gpio0 20 GPIO_ACTIVE_LOW   /* ROW2  D3  P0.20 */
            &gpio0 22 GPIO_ACTIVE_LOW   /* ROW3  D4  P0.22 */
            &gpio0 24 GPIO_ACTIVE_LOW   /* ROW4  D5  P0.24 */
            &gpio0 29 GPIO_ACTIVE_LOW   /* ROW5  D20 P0.29 */
            &gpio0 11 GPIO_ACTIVE_LOW   /* ROW6  D7  P0.11 */
            &gpio1 4  GPIO_ACTIVE_LOW   /* ROW7  D8  P1.04 */
        >;

        /* Columns */
        col-gpios = <
            &gpio0 9  GPIO_ACTIVE_LOW   /* COL1  D10 P0.09 */
            &gpio0 10 GPIO_ACTIVE_LOW   /* COL2  D16 P0.10 */
            &gpio1 11 GPIO_ACTIVE_LOW   /* COL3  D14 P1.11 */
            &gpio1 13 GPIO_ACTIVE_LOW   /* COL4  D15 P1.13 */
            &gpio1 15 GPIO_ACTIVE_LOW   /* COL5  D18 P1.15 */
        >;

        debounce-press-ms = <5>;
        debounce-release-ms = <5>;
    };
};
